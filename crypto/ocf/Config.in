## drivers/test/Kconfig
```kconfig
#
#TEST driver configuration 
#

menuconfig TEST
        tristate "Test support"

if TEST

config HELLO_TEST 
        tristate "Hello support"

config PARAM_TEST
        tristate "Parm support"


config  GLOBALMEM_TEST    
        tristate "globalmem support"

config  GLOBALFIFO_TEST    
        tristate "globalfifo support"

config  SECOND_DEVICE_TEST    
        tristate "second device support"

config   PLATFORM_DEVICE_DEMO   
        tristate "platform  device support"
config   PLATFORM_DRIVER_DEMO   
        tristate "platform  driver support"

config  MMAP_DRIVER   
        tristate "mmap kernel driver support"
endif   #TEST
```

## drivers/video/nxp/Kconfig
```kconfig
menu "NXP I2C encoder chips"
     depends on DRM && I2C

config DRM_I2C_NXP_TDA998X
	tristate "NXP Semiconductors TDA998X HDMI encoder"
	select HDMI
	help
	  Support for NXP Semiconductors TDA998X HDMI encoders.
endmenu
```
